## boards/myBoard/Kconfig.myBoard
```kconfig
# Copyright 2024 NXP
# SPDX-License-Identifier: Apache-2.0

config BOARD_MYBOARD
	select SOC_MCXA156 if BOARD_MYBOARD
	select SOC_PART_NUMBER_MCXA156VLL
```

## boards/myBoard/board.yml
```yaml
board:
  name: myBoard
  full_name: My Board
  vendor: iomico
  socs:
  - name: mcxa156
```

## boards/myBoardSScratch/Kconfig.myBoardSScratch
```kconfig
config BOARD_MYBOARDSSCRATCH
    select SOC_MCXA156 if BOARD_MYBOARDSSCRATCH
    select SOC_PART_NUMBER_MCXA156VLL
    
```

## boards/myBoardSScratch/board.yml
```yaml
board:
  name: myBoardSScratch
  full_name: My Custom MCXA156 Board From Scratch
  vendor: nxp
  socs:
    - name: mcxa156
```

## dts/bindings/sensor/custom,led-sensor.yaml
```yaml
description: Custom LED Sensor Driver

compatible: "custom,led-sensor"

include: sensor-device.yaml

properties:
  gpios:
    type: phandle-array
    required: true
    description: GPIO pin connected to the LED
```
