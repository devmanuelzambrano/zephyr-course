## app/Kconfig
```kconfig
mainmenu "Heartbeat LED Configuration"

config APP_HEARTBEAT_PERIOD_MS
    int "Heartbeat LED Blink Period (ms)"
    default 500
    range 100 2000
    help
      Sets the time, in milliseconds, that the LED will remain on and off.

source "Kconfig.zephyr"
```
