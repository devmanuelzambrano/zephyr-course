## CMakeLists.txt
```
cmake_minimum_required(VERSION 3.20.0)

list(APPEND BOARD_ROOT ${CMAKE_CURRENT_SOURCE_DIR}/..)
list(APPEND DTS_ROOT ${CMAKE_CURRENT_SOURCE_DIR}/..)
list(APPEND ZEPHYR_EXTRA_MODULES ${CMAKE_CURRENT_SOURCE_DIR}/..)

find_package(Zephyr REQUIRED)
project(my_zephyr_app)

target_sources(app PRIVATE src/main.cpp)
```

## Kconfig
```
mainmenu "Heartbeat LED Configuration"

config APP_HEARTBEAT_PERIOD_MS
    int "Heartbeat LED Blink Period (ms)"
    default 500
    range 100 2000
    help
      Sets the time, in milliseconds, that the LED will remain on and off.

source "Kconfig.zephyr"
```

## prj.conf
```kconfig
CONFIG_GPIO=y
CONFIG_LOG=y
CONFIG_SENSOR=y
CONFIG_LED_SENSOR=y
CONFIG_SHELL=y
```

## app.overlay
```dts
/ {
    aliases {
        app-led = &red_led;
    };

    my_led_sensor: led_sensor {
		compatible = "custom,led-sensor";
		gpios = <&gpio3 12 GPIO_ACTIVE_LOW>;
		status = "okay";
	};
};
```

## src/main.cpp
```c
#include <zephyr/kernel.h>
#include <zephyr/device.h>
#include <zephyr/drivers/sensor.h>
#include <zephyr/logging/log.h>

LOG_MODULE_REGISTER(main, LOG_LEVEL_INF);

int main(void)
{
	const struct device *dev = DEVICE_DT_GET(DT_NODELABEL(my_led_sensor));
	struct sensor_value val;

	if (!device_is_ready(dev)) {
		LOG_ERR("Sensor device not ready");
		return 0;
	}

	while (1) {
		sensor_sample_fetch(dev);
		LOG_INF("Fetch ejecutado: LED ON");
		k_sleep(K_MSEC(500));

		sensor_channel_get(dev, SENSOR_CHAN_ALL, &val);
		LOG_INF("Get ejecutado: LED OFF");
		k_sleep(K_MSEC(500));
	}

	return 0;
}
```
